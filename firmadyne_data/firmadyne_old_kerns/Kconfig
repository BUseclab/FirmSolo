## firmadyne_data/firmadyne_old_kerns/Kconfig
```kconfig
config FIRMADYNE
	bool "FIRMADYNE: Dynamic firmware analysis"
	help
		These are kernel changes to support firmware emulation and analysis.
```
